/*        d2
 *       ====  
 *  d7 ||    || d3
 *    d8 ==== 
 *  d6 ||    || d4
 *       ====  *
 *        d5    d9
 *  Common Anode
 */
// {a,b,c,d,e,f,g,dp}
byte digitsCA[][8] = { // 공통 양극(CA)
    {0,0,0,0,0,0,1,1}, //0
    {1,0,0,1,1,1,1,1}, //1
    {0,0,1,0,0,1,0,1}, //2
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    {0,1,1,1,0,0,0,1}  //f
  };
//{a,b,c,d,e,f,g,dp}
byte digitsCC[][8] = { // 공통 음극(CC)
    {1,1,1,1,1,1,0,0}, //0
    {0,1,1,0,0,0,0,0}, //1
    {1,1,0,1,1,0,1,0}, //2
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    {1,0,0,0,1,1,1,0}  //f
  };

void setup() {
  for(byte i = 2; i < 10 ; i++)  {
    pinMode(i, OUTPUT);
    digitalWrite(i, LOW);  // OFF
  }
}

void loop() {
   for (byte num = 0; num < 16; num++) {
    displayFND(num);
    delay(500);
  }
}

void displayFND(byte num)  {
  for(byte i = 2 ; i < 10 ; i++)  {
    digitalWrite(i, digitsCA[num][i-2]);
  }
}
