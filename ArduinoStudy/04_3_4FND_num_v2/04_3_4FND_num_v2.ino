/*  - 주제: 4자리 7세그먼트 표시하기
 *  - 기능: active display, '0123' 화면에 표시
    - 회로 연결
       핀번호   : 1   2   3   4   5   6   7   8   9   10  11  12
      (세그먼트)  e   d   dp  c   g   D1  b   D2  D3  f   a   D4
       아두이노 : 6   5   9   4   8   10  3   11  12  7   2   13  A0
    - KNUE OSlab 2019 study 2019.4.25.
*/

// 세그먼트 숫자 비트 패턴 (공통 양극 기준)
byte segmentCA[][8] = {
//{a, b, c, d, e, f, g, dp }
  {0, 0, 0, 0, 0, 0, 1, 1}, //0   0
  {1, 0, 0, 1, 1, 1, 1, 1}, //1   1
  {0, 0, 1, 0, 0, 1, 0, 1}, //2   2
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  {0, 0, 0, 0, 1, 0, 0, 0}  //9. 25
};

bool isCA = true;  //사용하는 부품에 따라 설정 변경(true: 공통양극, false: 공통음극)

const uint8_t digitPins[4] = { 10, 11, 12, 13 }; //digit 선택 핀 10-D1, 11-D2, 12-D3, 13-D4

const unsigned long delayT = 5;   //active display 지연 시간

void setup() {
  //포트 설정(세그먼트 8개, 자리수 4개, )
  for (byte i = 2; i < 14 ; i++)  {   //세그먼트: 2-a, 3-b, 4-c, 5-d, 6-e, 7-f, 8-g, 9-dp
    pinMode(i, OUTPUT);               //자리수:  10-D1, 11-D2, 12-D3, 13-D4
  }
}

void loop() {
  // 0,1,2,3을 순서대로 표시하기
  for (byte i = 0; i < 4; i++) {
    displayNUM(i, i);                 // 사용법: displayNUM(byte digitPinNo i, byte num)
    delay(delayT);
  }
}

// 원하는 자리에 숫자 표시
void displayNUM(byte dgtNo, byte num) {
  // 모든 자리 끄기
  for (int i = 0; i < 4; i++) {
    digitalWrite(digitPins[i], !isCA);
  }
  // 표시 자리 켜기
  digitalWrite(digitPins[dgtNo], isCA);

  // 숫자 세그먼트 각 비트 표시
  for (byte i = 2; i < 10; i++) {     //2-a, 3-b, 4-c, 5-d, 6-e, 7-f, 8-g, 9-dp
    if (isCA) {
      digitalWrite(i, segmentCA[num][i - 2]);   //공통 양극인 경우
    } else {
      digitalWrite(i, !segmentCA[num][i - 2]);  //공통 음극인 경우
    }
  }
}
